## app/Kconfig
```kconfig
# Heartbeat application configuration
config APP_HEARTBEAT_PERIOD_MS
    int "Heartbeat period (ms)"
    range 100 2000
    default 500
source "Kconfig.zephyr"
```

## boards/copy_board/board.yml
```yaml
board:
  name: copy_board
  full_name: Copy Board
  vendor: Abdesattar
  socs:
  - name: esp32c3
```

## boards/fromscratch_board/board.yml
```yaml
board:
  name: fromscratch_board
  full_name: From Scratch Board
  vendor: Abdesattar
  socs:
  - name: esp32c3
```
