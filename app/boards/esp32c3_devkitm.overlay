/ {
    leds {
        compatible = "gpio-leds";
        user_led: led_0 {
            gpios = <&gpio0 3 GPIO_ACTIVE_HIGH>;
            label = "User LED";
        };
    };

    aliases {
        led0 = &user_led;
    };
};
